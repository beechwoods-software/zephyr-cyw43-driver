## west.yml
```yaml
# Copyright (c) 2023 Nordic Beechwoods Software, Inc.
# SPDX-License-Identifier: Apache-2.0

manifest:
  #self:
  #  west-commands: scripts/west-commands.yml
  defaults:
    remote: zephyrproject-rtos
    
  remotes:
    - name: zephyrproject-rtos
      url-base: https://github.com/zephyrproject-rtos

  projects:
    - name: zephyr
      remote: zephyrproject-rtos
      revision: v4.1.0
      #revision: main
      import:
        # By using name-allowlist we can clone only the modules that are
        # strictly needed by the application.
        name-allowlist:
          - cmsis_6      # required by the ARM port
          - cmsis
          - hal_rpi_pico
          - mbedtls
          - hal_infineon
          - mcuboot
```
