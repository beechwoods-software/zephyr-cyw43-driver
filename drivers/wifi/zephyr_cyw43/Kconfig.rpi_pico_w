## drivers/wifi/zephyr_cyw43/Kconfig.rpi_pico_w
```kconfig
# Raspberry Pi Pico W WiFi driver options

# Copyright (c) 2023 Beechwoods Software
# SPDX-License-Identifier: Apache-2.0

menuconfig WIFI_ZEPHYR_CYW43
	bool "Infineon CYW43 Wifi support"
	default y
	select NET_L2_WIFI_MGMT
	select WIFI_USE_NATIVE_NETWORKING
	select GPIO
        select ENTROPY_GENERATOR
        select TEST_RANDOM_GENERATOR
        select PICOSDK_USE_UART
	#select SPI
	#select SPI_RPI_PICO_PIO	
        select PICOSDK_USE_PIO # This can be removed once Zephyr PIO-SPI works
	
#if WIFI_ZEPHYR_CYW43
config WIFI_ZEPHYR_CYW43_SHELL
	bool "CYW43 shell"
	depends on SHELL
	help
	  Enable CYW43 shell

config WIFI_CYW43_USE_CYW4343W
	bool "Use Infineon CYW4343W chip"
	help
		Use firmware for the CYW4343W chip in place of
		the CYW43439 on the Raspberry Pi Pico W.

config USE_PICOWI_PIOSPI
        bool "Use picowi PIO-SPI, but nothing else"
	default y

config LED_INIT_PRIORITY
        int "Wifi led driver init priority"
        default 80

# Options to have the driver start the DHCP client (for STA mode) or start
# the DHCP server (for AP mode).

config CYW43_WIFI_STA_AUTO_DHCPV4
        bool "Start DHCP client"
        default n
        select NET_DHCPV4        
        help
          Automatically start DHCP client in STA mode
          
config CYW43_WIFI_AP_AUTO_DHCPV4
        bool "Start DHCP server"
        default n
        select NET_DHCPV4_SERVER
        help
          Automatically start DHCP server in AP mode

config CYW43_WIFI_AP_AUTO_DHCPV4_ADDRESS
        string "IP address to be used for driver initiated AP network"
        depends on CYW43_WIFI_AP_AUTO_DHCPV4
        default "192.168.1.1"
        help
          IP address to be used for driver initiated AP network DHCP server

config CYW43_WIFI_AP_AUTO_DHCPV4_NETMASK
        string "IP netmask to be used for driver initiated AP network"
        depends on CYW43_WIFI_AP_AUTO_DHCPV4
        default "255.255.255.0"
        help
          IP netmask to be used for driver initiated AP network DHCP server
          
# Power Save params

config WIFI_ZEPHYR_CYW43_POWERSAVE_MODE
	int "Powersave Mode (0 - off, 1 - PM1(aggressive), 2 - PM2(perfomrance)"
	range 0 2
	default 0
	help
	  This chooses the basic powersave mode of the cyw43. PM1 saves more power, but
	  reduces throughput. PM2 doesn't significantly reduce throughput.

config WIFI_ZEPHYR_CYW43_POWERSAVE_PM2_SLEEP_RET_MS
	int "Powersave sleep return time (0-255 x 10ms)"
	range 0 255
	default 200
	help
	   The maximum time to wait before going back to sleep for CYW43_PM2_POWERSAVE_MODE mode.

config WIFI_ZEPHYR_CYW43_POWERSAVE_LI_BEACON_PERIOD
	int "Wake period (0-15)"
	range 0 15
	default 1
	help
	   Wake period is measured in beacon period.

config WIFI_ZEPHYR_CYW43_POWERSAVE_LI_DTIM_PERIOD
	int "Wake period (0-15)"
	range 0 15
	default 1
	help
	   Wake interval measured in DTIMs. If this is set to 0, the wake interval is measured in beacon periods.

config WIFI_ZEPHYR_CYW43_POWERSAVE_LI_ASSOC
	int "Wake interval (0-15)"
	range 0 15
	default 10
	help
	   Wake interval sent to the access point.


#endif
```

## dts/bindings/bluetooth/infineon,cyw43-bt-hci.yaml
```yaml
# Copyright (c) 2025, Dave Rensberger
# SPDX-License-Identifier: Apache-2.0

description: Infineon CYW43 Bluetooth HCI interface.

compatible: "infineon,cyw43-bt-hci"

include: bt-hci.yaml
    
```

## dts/bindings/gpio/infineon,cyw43-gpio.yaml
```yaml
# Copyright (c) 2025, Parker Liu
# SPDX-License-Identifier: Apache-2.0

description: Infineon CYW43 GPIO controller

compatible: "infineon,cyw43-gpio"

include: gpio-controller.yaml

properties:
  "#gpio-cells":
    const: 2

  ngpios:
    type: int
    required: true
    const: 3
    description: Number of GPIOs supported

gpio-cells:
  - pin
  - flags
```
